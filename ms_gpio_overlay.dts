/dts-v1/;
/plugin/;

// This is the "reference syntax" recommended by Android (but not supported with my dtc compiler)

&{/} {
    motion_sensor_detector {
        compatible = "scshafe,my_test_driver";

        pir-ms-up-gpios = <0x33 0x03 0x00>;        // Gpio 3   (P1_B 21 on cape, P9_21)
        pir-ms-lo-gpios = <0x42 0x10 0x00>;        // Gpio 48  (P1_B 15 on cape, P9_15 in base dts)

        
    };
};

/*


0x33 is the phandle for one of the gpio@0 targets
0x03 is the index in "gpio-line-names" that matches the gpio on the hardware

0x42 is the phandle for one of the gpio@0 targets
0x10 is the index


*/